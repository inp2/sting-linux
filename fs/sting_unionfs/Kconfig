## fs/sting_unionfs/Kconfig
```kconfig
config STING_UNION_FS
	tristate "STING union file system (EXPERIMENTAL)"
	depends on EXPERIMENTAL && STING
	help
	  A modification of unionfs for STING to launch and rollback attacks.

config STING_UNION_FS_XATTR
	bool "STING Unionfs extended attributes"
	depends on STING_UNION_FS
	help
	  STING unionfs extended attributes support.

config STING_UNION_FS_DEBUG
	bool "STING Debug Unionfs"
	depends on STING_UNION_FS
	help
	  If you say Y here, you can turn on debugging output from STING's unionfs.
```

## kernel/sting/Kconfig
```kconfig
config STING
	bool "Detect vulnerabilities in programs"
	depends on EXPERIMENTAL && X86_32 && PREEMPT && SECURITY_SELINUX
	help
	  STING is a system that detects name resolution vulnerabilities in
	  programs.

	  See http://siis.cse.psu.edu/sting/ for details.
	  If you are unsure how to answer this question, answer N.
```
